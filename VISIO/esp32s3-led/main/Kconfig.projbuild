## VISIO/esp32s3-led/main/Kconfig.projbuild
```kconfig
menu "Visio LED"
    config PIPALAB_LED_GPIO
        int "GPIO del LED (-1 = sin configurar)"
        range -1 48
        default -1
        help
            Elegir después de identificar el modelo y la revisión de la placa.
    choice PIPALAB_LED_TYPE
        prompt "Tipo de LED"
        default PIPALAB_LED_SIMPLE
        config PIPALAB_LED_SIMPLE
            bool "LED convencional"
        config PIPALAB_LED_RGB
            bool "WS2812 / RGB direccionable"
    endchoice
    config PIPALAB_LED_ACTIVE_LOW
        bool "LED convencional activo en nivel bajo"
        default n
endmenu
```

## VISIO/esp32s3-led/sdkconfig.defaults
```kconfig
CONFIG_IDF_TARGET="esp32s3"
CONFIG_BT_ENABLED=y
CONFIG_BT_BLUEDROID_ENABLED=n
CONFIG_BT_NIMBLE_ENABLED=y
CONFIG_BT_NIMBLE_SM_SC=y
CONFIG_BT_NIMBLE_SM_LEGACY=n
CONFIG_BT_NIMBLE_NVS_PERSIST=y
CONFIG_BT_NIMBLE_MAX_CONNECTIONS=1
CONFIG_ESPTOOLPY_FLASHSIZE_4MB=y
CONFIG_PIPALAB_LED_GPIO=-1
```
